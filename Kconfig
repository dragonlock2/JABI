## firmware/boards/usb_pdmon.conf
```kconfig
CONFIG_LOG=y
CONFIG_LOG_MODE_IMMEDIATE=n
CONFIG_LOG_PROCESS_TRIGGER_THRESHOLD=0
CONFIG_LOG_PROCESS_THREAD_SLEEP_MS=100

# Interface settings
CONFIG_JABI_REQ_PAYLOAD_MAX_SIZE=512
CONFIG_JABI_RESP_PAYLOAD_MAX_SIZE=512
CONFIG_JABI_THREAD_STACK_SIZE=2048

CONFIG_USB_DEVICE_STACK=y
CONFIG_USB_DEVICE_VID=0x0069
CONFIG_USB_DEVICE_PID=0x0420
CONFIG_USB_DEVICE_MANUFACTURER="JABI"
CONFIG_USB_DEVICE_PRODUCT="usb_pdmon"
CONFIG_USB_SELF_POWERED=n
CONFIG_USB_MAX_POWER=250

# Peripheral settings
CONFIG_JABI_UART_RX_BUFFER_SIZE=512
CONFIG_UART_INTERRUPT_DRIVEN=y
CONFIG_SERIAL=y
CONFIG_GPIO=y
CONFIG_ADC=y
```

## west.yml
```yaml
manifest:
  remotes:
    - name: dragonlock2
      url-base: https://github.com/dragonlock2

  projects:
    - name: zephyrboards
      remote: dragonlock2
      revision: 5a82186370369054d6ef01ffc0470636879a4527
      import: true

  self:
    path: JABI
```
